## Config.in
```kconfig
menu "ShareOS"

source "$BR2_EXTERNAL_SHAREOS_PATH/package/alt-f-utils/Config.in"
source "$BR2_EXTERNAL_SHAREOS_PATH/package/ksmbd-tools-shareos/Config.in"
source "$BR2_EXTERNAL_SHAREOS_PATH/package/uci/Config.in"
source "$BR2_EXTERNAL_SHAREOS_PATH/package/ucode/Config.in"
source "$BR2_EXTERNAL_SHAREOS_PATH/package/rpcd/Config.in"
source "$BR2_EXTERNAL_SHAREOS_PATH/package/shareos-core/Config.in"
source "$BR2_EXTERNAL_SHAREOS_PATH/package/shareos-tailscale/Config.in"
source "$BR2_EXTERNAL_SHAREOS_PATH/package/shareos-autobrr/Config.in"
source "$BR2_EXTERNAL_SHAREOS_PATH/package/shareos-tuya/Config.in"
source "$BR2_EXTERNAL_SHAREOS_PATH/package/shareos-zabbix-agent/Config.in"

endmenu

source "$BR2_EXTERNAL_SHAREOS_PATH/package/alt-f-utils/Config.in.host"
```

## package/ksmbd-tools-shareos/Config.in
```kconfig
config BR2_PACKAGE_KSMBD_TOOLS_SHAREOS
	bool "ksmbd-tools (3.5.3)"
	depends on BR2_USE_MMU # fork()
	depends on BR2_USE_WCHAR # libglib2
	depends on BR2_TOOLCHAIN_HAS_THREADS # libglib2, libnl
	depends on !BR2_PACKAGE_KSMBD_TOOLS # both install the same files
	select BR2_PACKAGE_LIBGLIB2
	select BR2_PACKAGE_LIBNL
	help
	  ksmbd kernel server userspace utilities, in a newer version than
	  buildroot's package (3.5.2): 3.5.3 passes the supplementary groups
	  of a user to the kernel, so access through a group (POSIX ACL
	  group:<name>) works over SMB (ksmbd issue #461). Use this instead
	  of BR2_PACKAGE_KSMBD_TOOLS (it is hidden while that one is on).

	  Drop this package when buildroot has ksmbd-tools >= 3.5.3.

	  https://github.com/cifsd-team/ksmbd-tools

comment "ksmbd-tools needs a toolchain w/ wchar, threads"
	depends on BR2_USE_MMU
	depends on !BR2_USE_WCHAR || !BR2_TOOLCHAIN_HAS_THREADS
```

## package/shareos-autobrr/Config.in
```kconfig
config BR2_PACKAGE_SHAREOS_AUTOBRR
	bool "shareos-autobrr"
	depends on BR2_PACKAGE_HOST_GO_TARGET_ARCH_SUPPORTS
	select BR2_PACKAGE_HOST_GO
	help
	  autobrr for the system app "autobrr": download automation from
	  IRC announce channels and RSS feeds, with its web interface
	  (from the autobrr release).

	  https://github.com/autobrr/autobrr
```

## package/shareos-ipp-usb/Config.in
```kconfig
config BR2_PACKAGE_SHAREOS_IPP_USB
	bool "shareos-ipp-usb"
	depends on BR2_PACKAGE_HOST_GO_TARGET_ARCH_SUPPORTS
	depends on BR2_PACKAGE_HOST_GO_TARGET_CGO_LINKING_SUPPORTS
	depends on BR2_TOOLCHAIN_HAS_THREADS # libusb
	select BR2_PACKAGE_HOST_GO
	select BR2_PACKAGE_LIBUSB
	help
	  ipp-usb for the system app "printer": makes a USB printer or
	  scanner that speaks IPP over USB (most printers since about
	  2015) available in the network – driverless printing (AirPrint,
	  Mopria, IPP Everywhere) and scanning (eSCL). DNS-SD through
	  static avahi service files, as the firmware's avahi-daemon has
	  no D-Bus.

	  https://github.com/OpenPrinting/ipp-usb
```

## package/shareos-tailscale/Config.in
```kconfig
config BR2_PACKAGE_SHAREOS_TAILSCALE
	bool "shareos-tailscale"
	depends on BR2_PACKAGE_HOST_GO_TARGET_ARCH_SUPPORTS
	select BR2_PACKAGE_HOST_GO
	help
	  Tailscale for the system app "tailscale": one small binary
	  (tailscaled with the CLI built in), features a NAS does not need
	  left out.

	  https://github.com/tailscale/tailscale
```

## package/shareos-tuya/Config.in
```kconfig
config BR2_PACKAGE_SHAREOS_TUYA
	bool "shareos-tuya"
	select BR2_PACKAGE_MBEDTLS
	help
	  Talks to Tuya smart-home devices in the local network
	  (protocol 3.3/3.4, no cloud) for the app permission "tuya".
```

## package/shareos-zabbix-agent/Config.in
```kconfig
config BR2_PACKAGE_SHAREOS_ZABBIX_AGENT
	bool "shareos-zabbix-agent"
	depends on BR2_USE_MMU # fork()
	select BR2_PACKAGE_PCRE2
	select BR2_PACKAGE_OPENSSL
	select BR2_PACKAGE_LIBOPENSSL
	help
	  The classic Zabbix agent (zabbix_agentd, written in C) for the
	  system app "zabbix-agent": only the agent – no server, proxy,
	  Java gateway or Go agent 2. A few MB of memory, so it fits the
	  small NAS boxes. Buildroot's own "zabbix" package needs glibc;
	  this one builds with musl. OpenSSL for encrypted connections
	  (PSK or certificates).

	  https://www.zabbix.com/
```
